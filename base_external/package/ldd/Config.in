## base_external/package/ldd/Config.in
```kconfig
config BR2_PACKAGE_LDD
	bool "ldd"
	depends on BR2_LINUX_KERNEL
	select BR2_PACKAGE_LINUX_HEADERS
	help
	  Includes scull and misc-modules packages from ldd repo
```
